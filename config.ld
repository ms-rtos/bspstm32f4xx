/*********************************************************************************************************
**
**                                北京翼辉信息技术有限公司
**
**                                  微型安全实时操作系统
**
**                                      MS-RTOS(TM)
**
**                               Copyright  All Rights Reserved
**
**--------------文件信息--------------------------------------------------------------------------------
**
** 文   件   名: config.ld
**
** 创   建   人: Jiao.jinxing
**
** 文件创建日期: 2020 年 04 月 07 日
**
** 描        述: 本文件由 IoT Studio 生成，用于配置链接脚本
*********************************************************************************************************/

#include "config.h"

/*********************************************************************************************************
  内存布局定义
*********************************************************************************************************/

MEMORY
{
  FLASH (rx)          : ORIGIN = BSP_CFG_KERN_ROM_BASE, LENGTH = BSP_CFG_KERN_ROM_SIZE
  RAM (xrw)           : ORIGIN = BSP_CFG_KERN_RAM_BASE, LENGTH = BSP_CFG_KERN_RAM_SIZE
  MS_SEGGER_RTT (xrw) : ORIGIN = 0x20000000, LENGTH = 4 * 1024
}

BOOT_STACK_SIZE = BSP_CFG_BOOT_STACK_SIZE;
KERN_HEAP_SIZE  = BSP_CFG_KERN_HEAP_SIZE;

/*********************************************************************************************************
  根据运行模式包括对应的链接脚本
*********************************************************************************************************/

#if BSP_CFG_RUN_IN == BSP_RUN_IN_SDRAM
#include "MS-RTOS-SDRAM.ld"
#else
#include "MS-RTOS-FLASH.ld"
#endif

/*********************************************************************************************************
  END
*********************************************************************************************************/
